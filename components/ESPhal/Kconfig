## components/ESPhal/Kconfig
```kconfig
menu "ESPhal Configuration"

    choice ESPHAL_BOARD_TYPE
        prompt "Board Type"
        default ESPHAL_BOARD_REV_A_REFRIGERATOR
        help
            Select the hardware board type for your ModuChill device.
            Each board type has different GPIO pin assignments and capabilities.

        config ESPHAL_BOARD_REV_A_REFRIGERATOR
            bool "Rev A - Refrigerator Controller"
            help
                Original refrigerator controller board with basic relay and sensor support.
                - 4x Relay outputs
                - 2x OneWire buses
                - 4x ADC channels
                - Status LEDs

        config ESPHAL_BOARD_REV_B_RIPENING_CHAMBER
            bool "Rev B - Ripening Chamber Controller"
            help
                Enhanced board for ripening chambers with additional sensors and outputs.
                - 6x Relay outputs
                - 3x OneWire buses
                - 6x ADC channels
                - Display interface
                - Extended I/O

        config ESPHAL_BOARD_REV_C_DISPLAY_UNIT
            bool "Rev C - Display Unit"
            help
                Compact display unit for user interface and basic control.
                - 2x Relay outputs
                - 1x OneWire bus
                - 2x ADC channels
                - TFT display interface
                - Touch controls

    endchoice

    config ESPHAL_ENABLE_DEBUG_LOGGING
        bool "Enable HAL Debug Logging"
        default n
        help
            Enable detailed debug logging for HAL operations.
            This will log all HAL resource requests and initialization steps.

    config ESPHAL_ONEWIRE_POWER_PIN
        bool "Use dedicated OneWire power pin"
        default y
        help
            Enable parasitic power for OneWire devices using dedicated power pin.
            Disable this if your OneWire devices have external power supply.

    config ESPHAL_ADC_SAMPLES
        int "ADC averaging samples"
        range 1 64
        default 8
        help
            Number of samples to average for ADC readings.
            Higher values provide more stable readings but slower response.

endmenu
```

## components/ESPhal/modules/rtc_module/Kconfig
```kconfig
menu "RTC Module Configuration"

    config ENABLE_RTC_MODULE
        bool "Enable RTC Module"
        default y
        help
            Enable Real-Time Clock module for timestamps and time tracking.
            Uses ESP32 internal RTC by default.

    config RTC_DEFAULT_TIMEZONE
        string "Default timezone"
        default "UTC"
        depends on ENABLE_RTC_MODULE
        help
            Default timezone string (e.g., "UTC", "UTC-3", "UTC+2").
            Can be changed at runtime via configuration.

    config RTC_PUBLISH_INTERVAL_SEC
        int "Time publish interval (seconds)"
        default 60
        range 10 3600
        depends on ENABLE_RTC_MODULE
        help
            How often to publish time information to SharedState.
            Lower values increase system load.

    config RTC_ENABLE_NTP_FUTURE
        bool "Prepare for NTP support (future)"
        default n
        depends on ENABLE_RTC_MODULE
        help
            Reserve configuration space for future NTP synchronization.
            Currently not implemented.

    config RTC_ENABLE_EXTERNAL_FUTURE
        bool "Prepare for external RTC support (future)"
        default n
        depends on ENABLE_RTC_MODULE
        help
            Reserve configuration space for external RTC chips (DS3231, etc).
            Currently not implemented.

endmenu
```

## components/ESPhal/modules/sensor_module/Kconfig
```kconfig
config ENABLE_DS18B20_SENSORS
    bool "Enable DS18B20 temperature sensors"
    default y
    help
        Enable support for DS18B20 OneWire temperature sensors.
        When disabled, DS18B20 sensor configurations in sensors.json
        will be ignored and the driver code will not be compiled.

config ENABLE_NTC_SENSORS
    bool "Enable NTC thermistor sensors"
    default y
    help
        Enable support for NTC thermistor temperature sensors on ADC channels.
        When disabled, NTC_10K sensor configurations in sensors.json
        will be ignored and the driver code will not be compiled.

config ENABLE_GPIO_INPUT_SENSORS
    bool "Enable GPIO input sensors"
    default y
    help
        Enable support for digital sensors connected to GPIO inputs
        (door switches, limit switches, etc.).
        When disabled, GPIO_INPUT sensor configurations in sensors.json
        will be ignored and the driver code will not be compiled.
```

## components/actuator_drivers/Kconfig
```kconfig
menu "Actuator Drivers Configuration"

    config ENABLE_RELAY_DRIVER
        bool "Enable Relay actuator driver"
        default y
        help
            Enable support for relay control with safety features
            like minimum on/off times and inrush current delays.

    config ENABLE_PWM_DRIVER
        bool "Enable PWM output driver"
        default y
        help
            Enable support for PWM outputs with features like
            soft start/stop, duty limits, and gamma correction.

    config ENABLE_STEPPER_DRIVER
        bool "Enable Stepper motor driver"
        default n
        help
            Enable support for stepper motor control with
            position tracking and acceleration profiles.

    config ENABLE_SERVO_DRIVER
        bool "Enable Servo motor driver"
        default n
        help
            Enable support for servo motor control with
            angle positioning and speed control.

    config ENABLE_H_BRIDGE_DRIVER
        bool "Enable H-Bridge motor driver"
        default n
        help
            Enable support for bidirectional DC motor control
            using H-Bridge drivers.

    config ACTUATOR_DRIVER_MAX_INSTANCES
        int "Maximum number of actuator instances"
        default 16
        range 1 64
        help
            Maximum number of actuator instances that can be configured.
            Each actuator instance consumes memory, so adjust based on
            your application needs.

    config ACTUATOR_DRIVER_DEFAULT_UPDATE_MS
        int "Default actuator update interval (ms)"
        default 100
        range 10 1000
        help
            Default interval for updating time-based actuators (ramping, etc).
            Can be overridden in runtime configuration.

    config ACTUATOR_EMERGENCY_STOP_ENABLED
        bool "Enable hardware emergency stop"
        default y
        help
            Enable hardware emergency stop functionality that
            immediately sets all actuators to safe state.

endmenu
```

## components/core/Kconfig.projbuild
```kconfig
menu "Memory Pool Configuration"

    config MEMORY_POOL_ENABLE
        bool "Enable Memory Pool System"
        default y
        help
            Enable deterministic memory allocation for critical components.
            Provides fixed-size memory pools with O(1) allocation/deallocation.

    config MEMORY_POOL_STRICT_MODE
        bool "Strict Mode (No Heap Fallback)"
        default y
        depends on MEMORY_POOL_ENABLE
        help
            Fail immediately on pool exhaustion. Recommended for production.
            When disabled, allows fallback to heap allocation (debug only).

    config MEMORY_POOL_DIAGNOSTICS
        bool "Enable Pool Diagnostics"
        default y
        depends on MEMORY_POOL_ENABLE
        help
            Track usage statistics and performance metrics.
            Adds minimal overhead but provides valuable insights.

    config MEMORY_POOL_POISON_FREED
        bool "Poison Freed Memory (Debug)"
        default n
        depends on MEMORY_POOL_ENABLE
        help
            Fill freed blocks with pattern 0xDEADBEEF for debugging.
            Helps detect use-after-free errors.

    config MEMORY_POOL_TINY_COUNT
        int "Tiny Blocks (32B) Count"
        default 128
        range 64 256
        depends on MEMORY_POOL_ENABLE
        help
            Number of 32-byte blocks for small allocations.

    config MEMORY_POOL_SMALL_COUNT
        int "Small Blocks (64B) Count"
        default 64
        range 32 128
        depends on MEMORY_POOL_ENABLE
        help
            Number of 64-byte blocks for standard events.

    config MEMORY_POOL_MEDIUM_COUNT
        int "Medium Blocks (128B) Count"
        default 32
        range 16 64
        depends on MEMORY_POOL_ENABLE
        help
            Number of 128-byte blocks for JSON payloads.

    config MEMORY_POOL_LARGE_COUNT
        int "Large Blocks (256B) Count"
        default 16
        range 8 32
        depends on MEMORY_POOL_ENABLE
        help
            Number of 256-byte blocks for sensor data batches.

    config MEMORY_POOL_XLARGE_COUNT
        int "XLarge Blocks (512B) Count"
        default 8
        range 4 16
        depends on MEMORY_POOL_ENABLE
        help
            Number of 512-byte blocks for web responses.

    config MEMORY_POOL_ALERT_THRESHOLD
        int "Low Memory Alert Threshold %"
        default 80
        range 50 95
        depends on MEMORY_POOL_ENABLE && MEMORY_POOL_DIAGNOSTICS
        help
            Trigger low memory warning when usage exceeds this percentage.

    config MEMORY_POOL_CRITICAL_THRESHOLD
        int "Critical Memory Alert Threshold %"
        default 95
        range 80 99
        depends on MEMORY_POOL_ENABLE && MEMORY_POOL_DIAGNOSTICS
        help
            Trigger critical memory alert when usage exceeds this percentage.

    config MEMORY_POOL_ALLOW_HEAP_FALLBACK
        bool "Allow Heap Fallback (Debug Only)"
        default n
        depends on MEMORY_POOL_ENABLE && !MEMORY_POOL_STRICT_MODE
        help
            Allow fallback to heap allocation when pools are exhausted.
            NOT recommended for production use.

endmenu
```

## components/sensor_drivers/Kconfig
```kconfig
menu "Sensor Drivers Configuration"

    config SENSOR_DRIVER_DS18B20_ASYNC_ENABLED
        bool "Enable DS18B20 Async driver"
        default y
        help
            Enable non-blocking DS18B20 driver with state machine.
            Saves ~18KB of flash if disabled.

    config SENSOR_DRIVER_NTC_ENABLED
        bool "Enable NTC thermistor driver"
        default y
        help
            Enable support for NTC thermistor temperature sensors.
            Disable to save ~10KB of flash if not using NTC.

    config SENSOR_DRIVER_PRESSURE_4_20MA_ENABLED
        bool "Enable 4-20mA pressure sensor driver"
        default n
        help
            Enable support for industrial 4-20mA pressure sensors.

    config SENSOR_DRIVER_GPIO_INPUT_ENABLED
        bool "Enable GPIO input driver"
        default y
        help
            Enable support for digital GPIO inputs (switches, buttons).

    config SENSOR_DRIVER_MAX_INSTANCES
        int "Maximum number of sensor instances"
        default 16
        range 1 64
        help
            Maximum number of sensor instances that can be configured.
            Each sensor instance consumes memory, so adjust based on
            your application needs.

    config SENSOR_DRIVER_DEFAULT_POLL_INTERVAL_MS
        int "Default sensor polling interval (ms)"
        default 1000
        range 100 60000
        help
            Default interval between sensor polls in milliseconds.
            Can be overridden in runtime configuration.

endmenu
```

## sdkconfig.defaults
```kconfig
# ModESP Configuration Defaults
# This file sets default configuration options for the project

# Disable C++ exceptions to save memory and improve performance
CONFIG_COMPILER_CXX_EXCEPTIONS=n
# CONFIG_CXX_EXCEPTIONS is not set

# Compiler optimizations
CONFIG_COMPILER_OPTIMIZATION_SIZE=y
CONFIG_COMPILER_OPTIMIZATION_ASSERTIONS_SILENT=y
CONFIG_COMPILER_STACK_CHECK_MODE_NORM=y

# System behavior
CONFIG_ESP_SYSTEM_PANIC_PRINT_HALT=y

# FreeRTOS settings for industrial applications
CONFIG_FREERTOS_HZ=1000
CONFIG_FREERTOS_TIMER_TASK_PRIORITY=2
CONFIG_FREERTOS_TIMER_TASK_STACK_DEPTH=4096

# Enable PSRAM support if available
CONFIG_ESP32_SPIRAM_SUPPORT=y
CONFIG_SPIRAM_USE_MALLOC=y

# Watchdog timers
CONFIG_ESP_TASK_WDT=y
CONFIG_ESP_TASK_WDT_TIMEOUT_S=5
CONFIG_ESP_TASK_WDT_PANIC=y

# Increase main task stack size for complex C++ operations
CONFIG_ESP_MAIN_TASK_STACK_SIZE=12288

# LittleFS Configuration  
CONFIG_PARTITION_TABLE_CUSTOM=y
CONFIG_PARTITION_TABLE_CUSTOM_FILENAME="partitions.csv"

# LittleFS support
CONFIG_VFS_SUPPORT_IO=y
CONFIG_LITTLEFS_MAX_PARTITIONS=1
CONFIG_LITTLEFS_PAGE_SIZE=256
CONFIG_LITTLEFS_OBJ_NAME_LEN=64
CONFIG_LITTLEFS_READ_SIZE=128
CONFIG_LITTLEFS_PROG_SIZE=128
CONFIG_LITTLEFS_BLOCK_SIZE=4096
CONFIG_LITTLEFS_CACHE_SIZE=512
CONFIG_LITTLEFS_LOOKAHEAD_SIZE=128
CONFIG_LITTLEFS_BLOCK_CYCLES=512
CONFIG_LITTLEFS_USE_MTIME=y

# Disable default file systems to save space
CONFIG_FATFS_VFS_FSTAT_BLKSIZE=0
```

## test/integration_test/sdkconfig.defaults
```kconfig
CONFIG_IDF_TARGET="esp32s3"

# Partition table
CONFIG_PARTITION_TABLE_CUSTOM=y
CONFIG_PARTITION_TABLE_CUSTOM_FILENAME="partitions.csv"

# Main task stack size for integration tests
CONFIG_MAIN_TASK_STACK_SIZE=16384

# FreeRTOS configuration
CONFIG_FREERTOS_HZ=100
CONFIG_FREERTOS_WATCHPOINT_END_OF_STACK=y

# Memory configuration
CONFIG_ESP_SYSTEM_CHECK_INT_LEVEL_5=y
CONFIG_ESP_ERR_TO_NAME_LOOKUP=y

# Debug configuration
CONFIG_ESP_DEBUG_OCDAWARE=y
CONFIG_ESP_SYSTEM_PANIC_PRINT_HALT=y

# WiFi for testing
CONFIG_ESP32_WIFI_ENABLED=y

# Logging
CONFIG_LOG_DEFAULT_LEVEL_INFO=y
CONFIG_LOG_MAXIMUM_LEVEL_VERBOSE=y 
```
